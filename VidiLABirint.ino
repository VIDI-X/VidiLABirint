// GPIO13 - MENU - Map To Serial
// GPIO27 - SELECT - Save map to SPIFS
// GPIO39 - STRAT - Load saved map from SPIFS
// GPIO34 - Left-Rigt - Move
// GPIO35 - Up-Down - Move

#include <FS.h>
#include <SPIFFS.h>
#include <SPI.h>
#include "Adafruit_ILI9341.h"
#include "Adafruit_GFX.h"

#define TFT_DC 21 // Data/Command VIDI X zaslona spojen je na PIN 21
#define TFT_CS 5  // Chip select VIDI X zaslona spojen je na PIN 5

#define speed 25  // Less is Fasster

#define CELL 2    // Definiramo veličinu jedne čelije u pixelaima
#define RAW 80    // Broj redova naše igre
#define COL 107   // Definiramo broj stupaca naše igre
#define ssf 3     // 320 pixels / COL

#define Player 9  // Naš igrač
#define wall 1    // zid
#define empty 0   // prazan prolaz

#define key 2     // 
#define door 3    // 
#define garlic 4  // 
#define vampire 5 // 


int startX = 3;
int startY = 6;

//int inPin = 39;  // Pin za Start gumb je 39
//const int inPin = 32;  // Pin za gumb A je 32
//int colPin = 0;        // Gumb volume za promijenu boje iscrtavanja čelija
const int col = 25;    // Poćetna boja čelija
//const int inPat = 13;  // gumb menu za random pattern
const int savePin = 27;
const int loadPin = 39;

const int btn_lir = 34;  // gumb lijevo desno
const int btn_uid = 35;  // gumb gore dolje
const int mapToSerialButton = 13;  //mapToSerial Button

// ovdije moramo definirati niz
// prema želji ga popuniti s poćenim stanjem svijeta
//uint8_t world[RAW][COL] = {};
//uint8_t next[RAW][COL];

uint8_t world[RAW][COL] = {0, 1, 1, 1, 1, 1, 1, 1, 1, 1, 1, 1, 1,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 1,
                          1, 1, 1, 1, 1, 1, 1, 1, 1, 1, 1, 1,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 1,
                          1, 1, 1, 0, 0, 0, 1, 1, 1, 0, 0, 0,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 1,
                          1, 1, 1, 0, 0, 0, 9, 0, 0, 0, 0, 0,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 1,
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                          1, 1, 1, 1, 1, 1, 1, 1, 1, 1, 1, 1,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 1,
                         };

// stvaranje TFT objekta (zaslon)
Adafruit_ILI9341 tft = Adafruit_ILI9341(TFT_CS, TFT_DC);

bool saveButtonState = false;
bool loadButtonState = false;

void fill_world_edges() {
  for (int i = 0; i < RAW; i++) {
    for (int j = 0; j < COL; j++) {
      if (i == 0 || i == RAW - 1 || j == 0 || j == COL - 1) {
        world[i][j] = wall;
      }
      if (i == 1 || i == RAW - 2 || j == 1 || j == COL - 2) {
        world[i][j] = wall;
      }
    }
  }
}

void generateRandomPattern() {
  for (int i = 1; i < RAW - 1; i = i + 3) {
    for (int j = 1; j < COL - 1; j = j + 3) {
      int tmp = random(3);
      world[i][j] = tmp;
      if (tmp == empty) {
        world[i - 1][j] = empty;
        world[i + 1][j] = empty;
        world[i][j - 1] = empty;
        world[i][j + 1] = empty;
        world[i - 1][j - 1] = empty;
        world[i + 1][j + 1] = empty;
        world[i + 1][j - 1] = empty;
        world[i - 1][j + 1] = empty;
      } else if (tmp == wall) {
        world[i - 1][j] = wall;
        world[i + 1][j] = wall;
        world[i][j - 1] = wall;
        world[i][j + 1] = wall;
        world[i - 1][j - 1] = wall;
        world[i + 1][j + 1] = wall;
        world[i + 1][j - 1] = wall;
        world[i - 1][j + 1] = wall;
      } else {
        world[i - 1][j] = empty;
        world[i + 1][j] = empty;
        world[i][j - 1] = empty;
        world[i][j + 1] = empty;
        world[i - 1][j - 1] = empty;
        world[i + 1][j + 1] = empty;
        world[i + 1][j - 1] = empty;
        world[i - 1][j + 1] = empty;
        world[i][j] = empty;
      }
    }
  }
}

void drawWorld() {
  for (int y = 0; y < RAW; y++) {
    for (int x = 0; x < COL; x++) {
      if (world[y][x] == wall) {
        tft.fillRect(x * ssf, y * ssf, CELL, CELL, col);
      } else if (world[y][x] == empty) {
        tft.fillRect(x * ssf, y * ssf, CELL, CELL, ILI9341_BLACK);
      } else if (world[y][x] == Player) {
        tft.fillRect(x * ssf, y * ssf, CELL, CELL, ILI9341_RED);
      }
    }
  }
}

void mapToSeraial() {

  bool mapToSerialButtonState = digitalRead(mapToSerialButton);

  if (mapToSerialButtonState == LOW) {
    Serial.print("uint8_t world[RAW][COL] = {");
    for (int y = 0; y < RAW; y++) {
      for (int x = 0; x < COL; x++) {
        if (world[y][x] == wall) {
          //Serial.print("#");
          Serial.print("1"); Serial.print(",");
        } else if (world[y][x] == empty) {
          //Serial.print(" ");
          Serial.print("0"); Serial.print(",");
        } else if (world[y][x] == Player) {
          //Serial.print("O");
          Serial.print("9"); Serial.print(",");
        }
      }
      Serial.println("");
    }
    Serial.print("};");
    delay(500);  // debounce delay
  }
}


void go_down() {
  for (int y = RAW - 1; y > 0; y--) {
    for (int x = 0; x < COL; x++) {
      if (world[y][x] == empty && world[y - 1][x] == Player) {
        world[y][x] = Player;
        world[y - 1][x] = empty;
      }
    }
  }
}

void go_up() {
  for (int y = 0; y < RAW - 1; y++) {
    for (int x = 0; x < COL; x++) {
      if (world[y][x] == empty && world[y + 1][x] == Player) {
        world[y][x] = Player;
        world[y + 1][x] = empty;
      }
    }
  }
}

void go_left() {
  for (int y = 0; y < RAW; y++) {
    for (int x = 0; x < COL - 1; x++) {
      if (world[y][x] == empty && world[y][x + 1] == Player) {
        world[y][x] = Player;
        world[y][x + 1] = empty;
      }
    }
  }
}

void go_right() {
  for (int y = 0; y < RAW; y++) {
    for (int x = COL - 1; x > 0; x--) {
      if (world[y][x] == empty && world[y][x - 1] == Player) {
        world[y][x] = Player;
        world[y][x - 1] = empty;
      }
    }
  }
}

void measure() {
  int playerX = -1, playerY = -1;

  // Find the player's position
  for (int i = 0; i < RAW; i++) {
    for (int j = 0; j < COL; j++) {
      if (world[i][j] == Player) {
        playerY = i;
        playerX = j;
        break;
      }
    }
    if (playerX != -1 && playerY != -1) break;
  }

  // Measure distances in each direction
  int distanceN = 0, distanceE = 0, distanceS = 0, distanceW = 0;

  // North
  for (int i = playerY - 1; i >= 0; i--) {
    if (world[i][playerX] == wall) break;
    distanceN++;
  }

  // East
  for (int i = playerX + 1; i < COL; i++) {
    if (world[playerY][i] == wall) break;
    distanceE++;
  }

  // South
  for (int i = playerY + 1; i < RAW; i++) {
    if (world[i][playerX] == wall) break;
    distanceS++;
  }

  // West
  for (int i = playerX - 1; i >= 0; i--) {
    if (world[playerY][i] == wall) break;
    distanceW++;
  }

  // Print the distances
  Serial.print("Distance; N: ");
  Serial.print(distanceN);
  Serial.print(", E: ");
  Serial.print(distanceE);
  Serial.print(", S: ");
  Serial.print(distanceS);
  Serial.print(", W: ");
  Serial.println(distanceW);
}
void saveWorld() {
  File file = SPIFFS.open("/world.bin", FILE_WRITE);
  if (!file) {
    Serial.println("Failed to create the file");
    return;
  }

  for (int i = 0; i < RAW; i++) {
    file.write(world[i], COL * sizeof(uint8_t));
  }

  file.close();
  Serial.println("World saved successfully");
}

void loadWorld() {
  File file = SPIFFS.open("/world.bin", FILE_READ);
  if (!file) {
    Serial.println("Failed to open the file");
    return;
  }

  for (int i = 0; i < RAW; i++) {
    file.read(world[i], COL * sizeof(uint8_t));
  }

  file.close();
  Serial.println("World loaded successfully");
}

void loadSave() {
  saveButtonState = digitalRead(savePin);
  loadButtonState = digitalRead(loadPin);

  if (saveButtonState == LOW) {
    saveWorld();
    delay(500);  // debounce delay
  }

  if (loadButtonState == LOW) {
    loadWorld();
    //drawWorld();  // redraw the loaded world
    delay(500);   // debounce delay
  }

  // Existing loop code...
}

void setup() {
  Serial.begin(115200);

  //generateRandomPattern();
  //fill_world_edges();
  world[startX][startY] = Player;

  // definiramo input pinove tj. upravljačke gumbe
  //pinMode(inPin, INPUT_PULLUP);  // A gumb mora biti definiran kao INPUT_PULLUP
  //pinMode(colPin, INPUT);
  //pinMode(inPat, INPUT);
  pinMode(btn_lir, INPUT_PULLUP);
  pinMode(btn_uid, INPUT_PULLUP);

  SPIFFS.begin(true);
  pinMode(savePin, INPUT_PULLUP);
  pinMode(loadPin, INPUT_PULLUP);
  // inicijalizacija zaslona
  tft.begin();
  // postavljamo orijentaciju ekzaslonarana
  tft.setRotation(3);
  // definiramo boju pozadine (crna troši najmanje struje)
  tft.fillScreen(ILI9341_BLACK);
  // pozvamo funkciju za iscrtavanje mreže
  //show_grid();
  drawWorld();
  delay(2000);
}

void loop() {
  loadSave();
  mapToSeraial();
  if (analogRead(btn_lir) > 4000) {
    go_left();
    Serial.print("Move: W; ");
    measure();  //Measure distance from N, E, S & W
    delay(speed);
  }

  if (analogRead(btn_lir) > 1800 && analogRead(btn_lir) < 2200) {
    go_right();
    Serial.print("Move: E; ");
    measure();  //Measure distance from N, E, S & W
    delay(speed);
  }

  if (analogRead(btn_uid) > 4000) {
    go_up();
    Serial.print("Move: N; ");
    measure();  //Measure distance from N, E, S & W
    delay(speed);
  }

  if (analogRead(btn_uid) > 1800 && analogRead(btn_uid) < 2200) {
    go_down();
    Serial.print("Move: S; ");
    measure();  //Measure distance from N, E, S & W
    delay(speed);
  }

  drawWorld();
}
